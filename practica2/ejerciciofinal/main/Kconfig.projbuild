## practica2/ejerciciofinal/main/Kconfig.projbuild
```kconfig
menu "Example Configuration"

    config LED1_GPIO
        int "LED1 GPIO number"
        default 34
        help
            GPIO number (IOxx) to blink on and off the LED1.
            Some GPIOs are used for other purposes (flash connections, etc.) and cannot be used to blink.

    config LED2_GPIO
        int "LED2 GPIO number"
        default 35
        help
            GPIO number (IOxx) to blink on and off the LED2.
            Some GPIOs are used for other purposes (flash connections, etc.) and cannot be used to blink.
    
    config LED3_GPIO
        int "LED3 GPIO number"
        default 32
        help
            GPIO number (IOxx) to blink on and off the LED3.
            Some GPIOs are used for other purposes (flash connections, etc.) and cannot be used to blink.

    config LED4_GPIO
        int "LED4 GPIO number"
        default 33
        help
            GPIO number (IOxx) to blink on and off the LED4.
            Some GPIOs are used for other purposes (flash connections, etc.) and cannot be used to blink.

endmenu
```

## practica2/timer/main/Kconfig.projbuild
```kconfig
menu "Example Configuration"

    config LED_GPIO
        int "LED GPIO number"
        default 14
        help
            GPIO number (IOxx) to blink on and off the LED.
            Some GPIOs are used for other purposes (flash connections, etc.) and cannot be used to blink.

endmenu
```

## practica3/ej1_sampling/main/Kconfig.projbuild
```kconfig
menu "Example Configuration"

    config READ_PERIOD
        int "Periodo de lectura"
        range 1 60
        default 2
        help
            Define el periodo de lectura, medido en segundos, con el que se obtienen datos desde el sensor Si7021.

    config TASK_PRIORITY
        int "Prioridad de la tarea encargada de realizar el muestreo"
        range 1 22
        default 5
        help
            Define la prioridad de la tarea que lleva a cabo el muestreo del sensor Si7021.

endmenu
```

## practica3/ej2_queue/main/Kconfig.projbuild
```kconfig
menu "Example Configuration"

    config READ_PERIOD
        int "Periodo de lectura"
        range 1 60
        default 2
        help
            Define el periodo de lectura, medido en segundos, con el que se obtienen datos desde el sensor Si7021.

    config TASK_PRIORITY
        int "Prioridad de la tarea encargada de realizar el muestreo"
        range 1 22
        default 5
        help
            Define la prioridad de la tarea que lleva a cabo el muestreo del sensor Si7021.

    config QUEUE_SIZE
        int "Tamaño máximo de la cola"
        range 1 20
        default 10
        help
            Define el tamaño máximo que registros que pueden almacenarse en la cola de mensajes antes de que esta se desborde.

endmenu
```

## practica3/ej4_estructuracion/components/i2c_config/Kconfig.projbuild
```kconfig
menu "I2C_CONFIG Configuration"

    config I2C_MASTER_SCL_IO 
        int "I2C_MASTER_SCL_IO PORT"
        default 27
        help
            Port for I2C SCL

    config I2C_MASTER_SDA_IO
        int "I2C_MASTER_SDA_IO PORT"
        default 26
        help
            Port for I2C SDA

endmenu
```

## practica3/ej4_estructuracion/components/monitor-temperature/Kconfig.projbuild
```kconfig
menu "TEMPERATUREMONITOR Configuration"

    config READ_PERIOD
        int "Read period for temperature and humidity (s)"
        range 1 60
        default 2
        help
            Define el periodo de lectura, medido en segundos, con el que se obtienen datos desde el sensor Si7021.

endmenu
```

## practica3/ej4_estructuracion/main/Kconfig.projbuild
```kconfig
menu "Example Configuration"

    config READ_PERIOD
        int "Periodo de lectura"
        range 1 60
        default 2
        help
            Define el periodo de lectura, medido en segundos, con el que se obtienen datos desde el sensor Si7021.


endmenu
```

## practica6/ej4_estructuracion/components/monitor-gpio/Kconfig.projbuild
```kconfig
menu "MONITOR-GPIO Configuration"

    config NBUTTON
        int "SCANNING FREQUENCY (s)"
        default 1
        help
            Scanning frecuency for button
    
    config BUTTON_GPIO_PORT
        int "GPIO INPUT PORT FOR BUTTON"
        default 25
        help
            GPIO input port for button

endmenu
```

## practica6/ej4_estructuracion2_sinPM/components/monitor-gpio/Kconfig.projbuild
```kconfig
menu "MONITOR-GPIO Configuration"

    config NBUTTON
        int "SCANNING FREQUENCY (s)"
        default 1
        help
            Scanning frecuency for button
    
    config BUTTON_GPIO_PORT
        int "GPIO INPUT PORT FOR BUTTON"
        default 25
        help
            GPIO input port for button

    config GPIO_WAKEUP_LEVEL
        int "GPIO LEVEL"
        range 0 1
        default 0
        help
            GPIO level

endmenu
```

## practica6/ej4_estructuracion2_sinPM/components/monitor-temperature/Kconfig.projbuild
```kconfig
menu "TEMPERATUREMONITOR Configuration"

    config READ_PERIOD
        int "Read period for temperature and humidity (s)"
        range 10 3600
        default 10
        help
            Define el periodo de lectura, medido en segundos, con el que se obtienen datos desde el sensor Si7021.

endmenu
```

## practica7/ej3_estructuracion3/components/monitor-gpio/Kconfig.projbuild
```kconfig
menu "MONITOR-GPIO Configuration"

    config NBUTTON
        int "SCANNING FREQUENCY (s)"
        default 1
        help
            Scanning frecuency for button
    
    config BUTTON_GPIO_PORT
        int "GPIO INPUT PORT FOR BUTTON"
        default 25
        help
            GPIO input port for button

    config OTA_BUTTON_GPIO_PORT
        int "GPIO INPUT PORT FOR OTA BUTTON"
        default 32
        help
            GPIO input port for button

endmenu
```
